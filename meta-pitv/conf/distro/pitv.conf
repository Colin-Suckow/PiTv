## meta-pitv/conf/distro/pitv.conf
```bitbake
require conf/distro/poky.conf

DISTRO_VERSION = "1.0"
DISTRO = "pitv"
DISTRO_NAME = "PiTv"

INIT_MANAGER = "systemd"

# Features not covered by the init-manager include
DISTRO_FEATURES:append = " pam polkit"

# Accepting these licenses probably has implications, but I don't really care
# because this is a small project that's only going to be used by 1-2 people.
LICENSE_FLAGS_ACCEPTED += "synaptics-killswitch commercial"

# meta-kde master still hardcodes S = "${UNPACKDIR}/git", which newer oe-core
# rejects. See the class for details; remove once meta-kde catches up.
INHERIT += "kde-unpackdir-s-fixup"
```

## meta-pitv/conf/layer.conf
```bitbake
# We have a conf and classes directory, add to BBPATH
BBPATH .= ":${LAYERDIR}"

# We have recipes-* directories, add to BBFILES
BBFILES += "${LAYERDIR}/recipes-*/*/*.bb \
            ${LAYERDIR}/recipes-*/*/*.bbappend"

BBFILE_COLLECTIONS += "meta-pitv"
BBFILE_PATTERN_meta-pitv = "^${LAYERDIR}/"
BBFILE_PRIORITY_meta-pitv = "26"
LAYERVERSION_meta-pitv = "1"
LAYERSERIES_COMPAT_meta-pitv = "wrynose"
```

## meta-pitv/wic/pitv.wks
```
# PiTv NVMe image layout.
# Uses nvme0n1 (Waveshare PoE M.2 HAT+) for partition placement.
#
# The boot partition uses --use-label so fstab gets "LABEL=boot" rather than
# a device path. wic's update_fstab() generates "/dev/nvme0n11" (missing 'p')
# for NVMe disks, which causes a 90-second timeout on boot. A label-based
# entry finds the correct partition regardless of device name.

part /boot --source bootimg-partition --ondisk nvme0n1 --fstype=vfat --label boot --active --align 4096 --size 100 --use-label
part / --source rootfs --ondisk nvme0n1 --fstype=ext4 --label root --align 4096
```
